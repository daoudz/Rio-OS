## Rio-OS-source/configs/buildroot_defconfig
```kconfig
# Rio-OS Buildroot defconfig
# Architecture
BR2_x86_64=y
BR2_x86_corei7=y

# Toolchain - musl with wchar and threads for MC/glib
BR2_TOOLCHAIN_BUILDROOT_MUSL=y
BR2_TOOLCHAIN_BUILDROOT_WCHAR=y
BR2_TOOLCHAIN_BUILDROOT_CXX=y

# Kernel
BR2_LINUX_KERNEL=y
BR2_LINUX_KERNEL_CUSTOM_VERSION=y
BR2_LINUX_KERNEL_CUSTOM_VERSION_VALUE="6.6.70"
BR2_LINUX_KERNEL_USE_CUSTOM_CONFIG=y
BR2_LINUX_KERNEL_CUSTOM_CONFIG_FILE="$(BR2_EXTERNAL_RIO_PATH)/configs/linux-rio.config"
BR2_LINUX_KERNEL_BZIMAGE=y

# Root filesystem
BR2_TARGET_ROOTFS_CPIO=y
BR2_TARGET_ROOTFS_CPIO_GZIP=y
BR2_TARGET_ROOTFS_ISO9660=y
BR2_TARGET_ROOTFS_ISO9660_BOOT_MENU="$(BR2_EXTERNAL_RIO_PATH)/configs/isolinux.cfg"
BR2_TARGET_ROOTFS_ISO9660_HYBRID=y

# Bootloader
BR2_TARGET_SYSLINUX=y

# Init system
BR2_INIT_BUSYBOX=y
BR2_ROOTFS_OVERLAY="$(BR2_EXTERNAL_RIO_PATH)/overlay"

# System config
BR2_TARGET_GENERIC_HOSTNAME="rio-os"
BR2_TARGET_GENERIC_ISSUE="Welcome to Rio-OS"
BR2_TARGET_GENERIC_GETTY=y
BR2_TARGET_GENERIC_GETTY_PORT="tty1"
BR2_SYSTEM_BIN_SH_BUSYBOX=y
BR2_SYSTEM_DEFAULT_PATH="/bin:/sbin:/usr/bin:/usr/sbin"

# Packages - File Manager (requires wchar + threads + glib2)
BR2_PACKAGE_MC=y

# Packages - ncurses for terminal UI
BR2_PACKAGE_NCURSES=y
BR2_PACKAGE_NCURSES_WCHAR=y

# Packages - Filesystem tools
BR2_PACKAGE_DOSFSTOOLS=y
BR2_PACKAGE_DOSFSTOOLS_FSCK_FAT=y
BR2_PACKAGE_DOSFSTOOLS_MKFS_FAT=y
BR2_PACKAGE_EXFATPROGS=y

# Packages - Disk/mount utilities
BR2_PACKAGE_UTIL_LINUX=y
BR2_PACKAGE_UTIL_LINUX_MOUNT=y
BR2_PACKAGE_UTIL_LINUX_LSBLK=y
BR2_PACKAGE_UTIL_LINUX_BLKID=y
BR2_PACKAGE_UTIL_LINUX_FINDMNT=y

# Disable unneeded image types
# BR2_TARGET_ROOTFS_EXT2 is not set
# BR2_TARGET_ROOTFS_TAR is not set
```
